## sdkconfig.defaults
```kconfig
CONFIG_ESPTOOLPY_FLASHSIZE_4MB=y
CONFIG_FREERTOS_TIMER_TASK_STACK_DEPTH=4096
CONFIG_ESP_RMAKER_MAX_PARAM_DATA_SIZE=4096
CONFIG_ESP_RMAKER_WORK_QUEUE_TASK_STACK=8192
CONFIG_PARTITION_TABLE_CUSTOM=y
CONFIG_PARTITION_TABLE_CUSTOM_FILENAME="partitions.csv"
CONFIG_ESP_RMAKER_ENABLE_CHALLENGE_RESPONSE=n
# Increase HTTP Client Buffer to handle long S3 URLs
CONFIG_ESP_HTTP_CLIENT_BUFFER_SIZE=4096
CONFIG_ESP_HTTP_CLIENT_BUFFER_SIZE_TX=4096

# BLE Provisioning Support
CONFIG_BT_ENABLED=y
CONFIG_BT_NIMBLE_ENABLED=y
CONFIG_ESP_WIFI_PROV_TRANSPORT_BLE=n
CONFIG_APP_WIFI_PROV_TRANSPORT_SOFTAP=y

# HomeKit HTTP server: increase sockets to support multiple iPhones/HomePods
CONFIG_HAP_HTTP_MAX_OPEN_SOCKETS=6

# Enable HAP Session Keep-Alive to detect and purge stale (zombie) sessions
# Without this, dead connections occupy sockets for minutes, causing "No Response"
CONFIG_HAP_SESSION_KEEP_ALIVE_ENABLE=y

# Increase total LWIP socket pool to accommodate all concurrent services:
# HAP(6) + mDNS(2) + ESP-NOW(1) + OTA(2) + WebServer(2) + margin(3) = 16
CONFIG_LWIP_MAX_SOCKETS=16

# Optimize TCP timers for faster socket recycling on LAN
# Default MSL=60000 causes 120s TIME_WAIT per closed socket — too slow for 16 sockets
CONFIG_LWIP_TCP_MSL=10000
CONFIG_LWIP_TCP_FIN_WAIT_TIMEOUT=5000

# Faster Gratuitous ARP so router/iPhone re-discovers ESP32 quicker after reconnect
CONFIG_LWIP_GARP_TMR_INTERVAL=30

# Restore last DHCP IP after reboot to avoid IP change and HomeKit re-discovery delay
CONFIG_LWIP_DHCP_RESTORE_LAST_IP=y

# Increase HTTP server header limits to fix "Header fields are too long"
CONFIG_HTTPD_MAX_REQ_HDR_LEN=1024
CONFIG_HTTPD_MAX_URI_LEN=1024
CONFIG_HTTPD_MAX_URI_HANDLERS=64

# Optimization for TLS (Saves heap)
CONFIG_MBEDTLS_DYNAMIC_BUFFER=y
CONFIG_MBEDTLS_DYNAMIC_FREE_CONFIG_DATA=y
CONFIG_MBEDTLS_DYNAMIC_FREE_CA_CERT=y

# Increase default stacks for network tasks
CONFIG_ESP_MAIN_TASK_STACK_SIZE=8192
CONFIG_PTHREAD_TASK_STACK_SIZE_DEFAULT=8192

# Enable OTA Rollback
CONFIG_BOOTLOADER_APP_ROLLBACK_ENABLE=y

# Allow OTA without certificate verification (for memory-constrained devices)
# WARNING: This is insecure and should only be used for testing or trusted networks
CONFIG_ESP_HTTPS_OTA_ALLOW_HTTP=y
CONFIG_ESP_TLS_INSECURE=y
CONFIG_ESP_TLS_SKIP_SERVER_CERT_VERIFY=y
```

## sdkconfig.defaults.esp32
```kconfig
# Device Role Configuration for Standard ESP32
CONFIG_APP_ESPNOW_AC_MASTER=y
CONFIG_APP_ESPNOW_AC_MAC="48:ca:43:cf:ff:68"

CONFIG_APP_ESPNOW_FAN_MASTER=y
CONFIG_APP_ESPNOW_FAN_MAC="48:ca:43:cf:ff:68"

CONFIG_APP_ESPNOW_TEMP_MASTER=y
CONFIG_APP_ESPNOW_TEMP_MAC="d0:cf:13:2f:e0:f0"

CONFIG_APP_ESPNOW_LED1_MASTER=y
CONFIG_APP_ESPNOW_LED1_MAC="e4:65:b8:11:7f:9c"

CONFIG_APP_ESPNOW_RELAY_MASTER=y
CONFIG_APP_ESPNOW_RELAY_MAC="48:ca:43:cb:08:b0"

CONFIG_APP_BUTTON_GPIO=0
CONFIG_APP_BUTTON_ACTIVE_LEVEL=0

# Sync Peers Configuration
CONFIG_APP_ESPNOW_SYNC_PEER_1="48:ca:43:cf:ff:68"
CONFIG_APP_ESPNOW_SYNC_PEER_2="d0:cf:13:2f:e0:f0"
CONFIG_APP_ESPNOW_SYNC_PEER_3="48:ca:43:cb:08:b0"

# LED Hardware Configuration (Slave/Standalone features)
CONFIG_APP_ESPNOW_LED1_SLAVE=y
CONFIG_APP_LED1_NAME="Lamp 1"
CONFIG_APP_LED1_CONTROL=y
CONFIG_APP_LED1_TYPE_SINGLE=y
CONFIG_APP_LED1_GPIO=4

# Generic Defaults
CONFIG_APP_OTA_ENABLE=y
CONFIG_OTA_SERVER_URL="http://Mac-mini-cua-ang.local:5555"

# Disable Power Management on ESP32 (S3 specific features might conflict)
CONFIG_PM_ENABLE=n
```

## sdkconfig.defaults.esp32c3
```kconfig
# ESP32-C3 Configuration
CONFIG_BT_ENABLED=y
CONFIG_BT_NIMBLE_ENABLED=y
CONFIG_ESP_WIFI_PROV_TRANSPORT_BLE=y
CONFIG_APP_WIFI_PROV_TRANSPORT_BLE=y
CONFIG_APP_WIFI_PROV_TRANSPORT_SOFTAP=n

# Device Role Configuration
CONFIG_APP_ESPNOW_AC_SLAVE=y

CONFIG_APP_ESPNOW_FAN_SLAVE=y

CONFIG_APP_ESPNOW_TEMP_MASTER=y
CONFIG_APP_ESPNOW_TEMP_MAC="d0:cf:13:2f:e0:f0"

CONFIG_APP_ESPNOW_LED1_MASTER=y
CONFIG_APP_ESPNOW_LED1_MAC="e4:65:b8:11:7f:9c"

CONFIG_APP_ESPNOW_RELAY_MASTER=y
CONFIG_APP_ESPNOW_RELAY_MAC="48:ca:43:cb:08:b0"

# Sync Peers Configuration
CONFIG_APP_ESPNOW_SYNC_PEER_1="d0:cf:13:2f:e0:f0"
CONFIG_APP_ESPNOW_SYNC_PEER_2="e4:65:b8:11:7f:9c"
CONFIG_APP_ESPNOW_SYNC_PEER_3="48:ca:43:cb:08:b0"

# LCD & UI Configuration
CONFIG_LV_FONT_MONTSERRAT_14=y
CONFIG_LV_FONT_MONTSERRAT_18=y
CONFIG_LV_FONT_MONTSERRAT_24=y
CONFIG_LV_FONT_MONTSERRAT_28=y
CONFIG_LV_FONT_MONTSERRAT_48=y
CONFIG_LV_COLOR_16_SWAP=y

# Flash Size Configuration (4MB for C3)
CONFIG_ESPTOOLPY_FLASHSIZE_4MB=y
CONFIG_ESPTOOLPY_FLASHSIZE="4MB"

# Compiler Optimization
CONFIG_COMPILER_OPTIMIZATION_SIZE=y
# CONFIG_COMPILER_OPTIMIZATION_DEBUG is not set
```

## sdkconfig.defaults.esp32s3
```kconfig
# PSRAM Configuration for ESP32-S3 (Disabled due to hardware mismatch)
CONFIG_SPIRAM=n

# Device Role Configuration
CONFIG_APP_ESPNOW_AC_MASTER=y
CONFIG_APP_ESPNOW_AC_MAC="48:ca:43:cf:ff:68"

CONFIG_APP_ESPNOW_FAN_MASTER=y
CONFIG_APP_ESPNOW_FAN_MAC="48:ca:43:cf:ff:68"

CONFIG_APP_ESPNOW_TEMP_MASTER=y
CONFIG_APP_ESPNOW_TEMP_MAC="48:ca:43:cf:ff:68"

CONFIG_APP_ESPNOW_LED1_MASTER=y
CONFIG_APP_ESPNOW_LED1_MAC="e4:65:b8:11:7f:9c"

CONFIG_APP_ESPNOW_RELAY_MASTER=y
CONFIG_APP_ESPNOW_RELAY_MAC="48:ca:43:cb:08:b0"

# LCD Configuration
CONFIG_APP_LCD_ENABLE=y
CONFIG_APP_LCD_BACKLIGHT_GPIO=6
CONFIG_APP_LCD_CS_GPIO=5
CONFIG_APP_LCD_DC_GPIO=4
CONFIG_APP_LCD_RST_GPIO=3
CONFIG_APP_LCD_MOSI_GPIO=2
CONFIG_APP_LCD_SCLK_GPIO=1
CONFIG_APP_LCD_H_RES=240
CONFIG_APP_LCD_V_RES=240
CONFIG_APP_LCD_SPI_HOST=0

# Sensor Configuration
CONFIG_APP_ESPNOW_TEMP_SLAVE=y
CONFIG_LAMP_SENSOR_AHT20=y
CONFIG_APP_I2C_SDA=7
CONFIG_APP_I2C_SCL=8

# Button Configuration
CONFIG_APP_BUTTON_GPIO=0
CONFIG_APP_BUTTON_ACTIVE_LEVEL=0

# Sync Peers Configuration
CONFIG_APP_ESPNOW_SYNC_PEER_1="48:ca:43:cf:ff:68"
CONFIG_APP_ESPNOW_SYNC_PEER_2="e4:65:b8:11:7f:9c"
CONFIG_APP_ESPNOW_SYNC_PEER_3="48:ca:43:cb:08:b0"

# LVGL Font Configuration
CONFIG_LV_FONT_MONTSERRAT_14=y
CONFIG_LV_FONT_MONTSERRAT_18=y
CONFIG_LV_FONT_MONTSERRAT_24=y
CONFIG_LV_FONT_MONTSERRAT_28=y
CONFIG_LV_FONT_MONTSERRAT_48=y

# Flash Size Configuration
CONFIG_ESPTOOLPY_FLASHSIZE_4MB=y
CONFIG_ESPTOOLPY_FLASHSIZE="4MB"
# LVGL Sharpness Fix
CONFIG_LV_COLOR_16_SWAP=y
```

## test_app/main/Kconfig.projbuild
```kconfig
menu "Hardware Configuration"

    config APP_LED_CONTROL
        bool "Enable LED Control (WS2812B)"
        default n
        help
            Enable support for WS2812B LED control (Web UI & RainMaker).
            If disabled, LED driver and related APIs will not be compiled.

    config APP_LED_GPIO
        int "LED GPIO"
        default 2
        help
            GPIO number for the RGB LED (WS2812B).

    config APP_BUTTON_GPIO
        int "Button GPIO"
        default 3
        help
            GPIO number for the onboard button.

    config APP_BUTTON_ACTIVE_LEVEL
        int "Button Active Level"
        default 0
        range 0 1
        help
            0: Active Low, 1: Active High.

    config APP_IR_TX_GPIO
        int "IR Transmitter GPIO"
        default 8
        help
            GPIO number for the IR Transmitter LED.

    config APP_IR_RX_GPIO
        int "IR Receiver GPIO"
        default 9
        help
            GPIO number for the IR Receiver Module.

endmenu

menu "Sensors"

    config LAMP_SENSOR_AHT20
        bool "Enable AHT20 Temperature & Humidity Sensor"
        default n
        help
            Enable support for AHT20 sensor.
            Adds sensor readings to RainMaker, HomeKit, and Web UI.
            Requires I2C connection.

    config APP_I2C_SDA
        int "I2C SDA GPIO"
        default 6
        depends on LAMP_SENSOR_AHT20
        help
            GPIO number for I2C SDA line.

    config APP_I2C_SCL
        int "I2C SCL GPIO"
        default 5
        depends on LAMP_SENSOR_AHT20
        help
            GPIO number for I2C SCL line.

endmenu
```

## test_app/sdkconfig.defaults
```kconfig
CONFIG_IDF_TARGET="esp32c3"
CONFIG_APP_IR_TX_GPIO=8
CONFIG_APP_IR_RX_GPIO=9
CONFIG_FREERTOS_HZ=100
CONFIG_APP_LED_GPIO=2
```
